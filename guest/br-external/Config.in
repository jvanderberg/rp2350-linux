## guest/br-external/package/micropython-machine/Config.in
```kconfig
config BR2_PACKAGE_MICROPYTHON_MACHINE
	bool "micropython-machine"
	depends on BR2_PACKAGE_MICROPYTHON
	help
	  MicroPython's machine module (Pin, I2C, SPI, PWM, ADC) on the
	  Linux GPIO character device, i2c-dev, spidev, the PWM class and
	  IIO, plus the fcntl.ioctl it needs, built into MicroPython.
```

## guest/br-external/package/pins-examples/Config.in
```kconfig
config BR2_PACKAGE_PINS_EXAMPLES
	bool "pins-examples"
	help
	  Example C programs for the board's pins (GPIO blink and edge
	  interrupts, I2C scan, SPI transfer, ADC) in
	  /usr/share/examples/pins, built and as source for compiling on
	  the board.
```

## guest/br-external/package/tcc/Config.in
```kconfig
config BR2_PACKAGE_TCC
	bool "tcc"
	depends on BR2_RISCV_32
	depends on BR2_TOOLCHAIN_USES_MUSL
	help
	  TinyCC, a small C compiler, assembler and linker, with an
	  rv32ima ilp32 soft-float back end (0001-*.patch). Installs it
	  as /usr/bin/cc with what it needs to build programs on the
	  target: the musl headers, crt1.o, a subset of the kernel
	  UAPI headers (GPIO, I2C, SPI, input, ...) and the libgcc
	  soft-float and long long helpers.

	  https://repo.or.cz/tinycc.git
```

## guest/buildroot.defconfig
```kconfig
# rv32ima, no FPU, no compressed: matches the emulator and Hazard3 (minus C)
BR2_riscv=y
BR2_riscv_custom=y
BR2_RISCV_ISA_RVM=y
BR2_RISCV_ISA_RVA=y
BR2_RISCV_32=y
BR2_RISCV_USE_MMU=y
BR2_RISCV_ABI_ILP32=y
# small static userland
BR2_TOOLCHAIN_BUILDROOT_MUSL=y
BR2_KERNEL_HEADERS_6_12=y
BR2_STATIC_LIBS=y
BR2_OPTIMIZE_S=y
BR2_STRIP_strip=y
BR2_TARGET_GENERIC_HOSTNAME="rp2350"
BR2_TARGET_GENERIC_ISSUE="rvemu guest"
BR2_ROOTFS_DEVICE_CREATION_DYNAMIC_DEVTMPFS=y
BR2_TARGET_GENERIC_GETTY_PORT="ttyS0"
BR2_TARGET_ROOTFS_CPIO=y
# BR2_TARGET_ROOTFS_TAR is not set
BR2_ROOTFS_POST_BUILD_SCRIPT="/guest/post-build.sh"
```

## guest/linux/drivers/rvemu/Kconfig
```kconfig
# SPDX-License-Identifier: GPL-2.0
# Devices of the rvemu machine: the RP2350's pins as the emulator presents
# them (rvemu-rs/rvcore/src/periph.rs), and the firmware's native engine
# (rvemu-rs/rvaccel). guest/build.sh copies this directory into the kernel
# tree.

config RVEMU_GPIO
	bool "rvemu GPIO controller"
	depends on GPIOLIB && OF
	select GPIOLIB_IRQCHIP
	help
	  The rvemu machine's GPIO controller: the RP2350's pads, with pulls
	  and edge interrupts.

config RVEMU_PWM
	bool "rvemu PWM controller"
	depends on PWM && OF
	help
	  The rvemu machine's PWM controller: one channel per GPIO, on the
	  RP2350's PWM slices.

config RVEMU_ADC
	bool "rvemu ADC"
	depends on IIO && OF
	help
	  The rvemu machine's ADC: the RP2350B's ADC inputs GP40-GP47 and its
	  temperature sensor.

config RVEMU_I2C
	bool "rvemu I2C controllers"
	depends on I2C && OF
	help
	  The rvemu machine's I2C controllers: the RP2350's I2C0 and I2C1,
	  driven synchronously by the emulator.

config RVEMU_SPI
	bool "rvemu SPI controller"
	depends on SPI_MASTER && OF
	help
	  The rvemu machine's SPI controllers, one per RP2350 SPI block
	  (SPI1 carries the SD card), driven synchronously by the emulator.

config RVEMU_CRYPTO
	bool "rvemu native crypto engine"
	depends on RISCV_SBI
	help
	  /dev/rvemu-crypto: the rvemu machine's native buffer engine (SBI
	  extension 0x0a000001): X25519, Ed25519, ChaCha20-Poly1305,
	  sntrup761 and LZ4, run by the firmware in time slices. The device
	  appears only when the firmware has the engine.

config RVEMU_SSH
	bool "rvemu SSH packet engine"
	depends on RVEMU_CRYPTO
	help
	  /dev/rvemu-ssh: chacha20-poly1305@openssh.com packets sealed and
	  opened by the native engine, for Dropbear.

config RVEMU_BENCH
	bool "rvemu benchmark points"
	depends on RISCV_SBI
	help
	  /dev/rvemu-bench: points at which the firmware records its cycle
	  counters (SBI extension 0x0a000002), and the report it prints on
	  its console.
```
